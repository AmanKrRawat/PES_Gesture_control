## CMakeLists.txt
```
# SPDX-License-Identifier: Apache-2.0

cmake_minimum_required(VERSION 3.20.0)

find_package(Zephyr REQUIRED HINTS $ENV{ZEPHYR_BASE})
project(Embedded_project_ble)

FILE(GLOB app_sources src/*.c)
target_sources(app PRIVATE
  ${app_sources}
  )

zephyr_library_include_directories(${ZEPHYR_BASE}/samples/bluetooth)
```

## prj.conf
```kconfig
CONFIG_BT=y
CONFIG_BT_DEBUG_LOG=y
CONFIG_BT_SMP=y
CONFIG_BT_PERIPHERAL=y
CONFIG_BT_DIS=y
CONFIG_BT_DIS_PNP=n
CONFIG_BT_BAS=y
CONFIG_BT_HRS=y
CONFIG_BT_DEVICE_NAME="Zephyr Heartrate Sensor"
CONFIG_BT_DEVICE_APPEARANCE=833
CONFIG_I2C=y
CONFIG_SENSOR=y
CONFIG_MPU6050=y
CONFIG_I2C_NRFX=y
CONFIG_MPU6050_TRIGGER_NONE=y
CONFIG_CBPRINTF_FP_SUPPORT=y
CONFIG_USE_SEGGER_RTT=y
CONFIG_RTT_CONSOLE=y
CONFIG_UART_CONSOLE=y
```

## src/main.c
```c
/* main.c - Application main entry point */

/*
 * Copyright (c) 2015-2016 Intel Corporation
 *
 * SPDX-License-Identifier: Apache-2.0
 */

#include <zephyr/types.h>
#include <stddef.h>
#include <string.h>
#include <errno.h>
#include <sys/printk.h>
#include <sys/byteorder.h>
#include <zephyr.h>
#include <device.h>
#include <stdio.h>
#include <drivers/sensor.h>

#include "window.h"
#include "classifier.h"
#include "bluetooth_file.h"


float sample[6] = {0};

const uint16_t features_count = 48;
float features[48];
uint16_t head = 0;
float queue[246];


                    



static int process_mpu6050(const struct device *dev)
{
	struct sensor_value accel[3];
	struct sensor_value gyro[3];
	int rc = sensor_sample_fetch(dev);

	if (rc == 0) {
		rc = sensor_channel_get(dev, SENSOR_CHAN_ACCEL_XYZ,
					accel);
	}
	if (rc == 0) {
		rc = sensor_channel_get(dev, SENSOR_CHAN_GYRO_XYZ,
					gyro);
	}
	if (rc == 0) {
		/*printf("%f,%f,%f,%f,%f,%f\n",
		       sensor_value_to_double(&accel[0]),
		       sensor_value_to_double(&accel[1]),
		       sensor_value_to_double(&accel[2]),
		       sensor_value_to_double(&gyro[0]),
		       sensor_value_to_double(&gyro[1]),
		       sensor_value_to_double(&gyro[2])); */
	} else {
		printf("sample fetch/get failed: %d\n", rc);
	}
	sample[0] = sensor_value_to_double(&accel[0]);
	sample[1] = sensor_value_to_double(&accel[1]);
	sample[2] = sensor_value_to_double(&accel[2]);
	sample[3] = sensor_value_to_double(&gyro[0]);
	sample[4] = sensor_value_to_double(&gyro[1]);
	sample[5] = sensor_value_to_double(&gyro[2]);


	return rc;
}





static void bas_notify(void)
{
	char menu = 'E';
	bt_bas_set_battery_level(menu);
}

static void hrs_notify(char menu)
{
	//char menu = 'D';
	bt_hrs_notify(menu);
}

void main(void)
{
	int err;

	err = bt_enable(NULL);
	if (err) {
		printk("Bluetooth init failed (err %d)\n", err);
		return;
	}

	bt_ready();

	bt_conn_auth_cb_register(&auth_cb_display);


	const char *const label = DT_LABEL(DT_INST(0, invensense_mpu6050));
	const struct device *mpu6050 = device_get_binding(label);

	if (!mpu6050) {
		printf("Failed to find sensor %s\n", label);
		return;
	}

	/* Implement notification. At the moment there is no suitable way
	 * of starting delayed work so we do it here
	 */
	while (1) {
		k_sleep(K_SECONDS(0.05));

		/* Heartrate measurements simulation */
		//hrs_notify('D');
		//k_sleep(K_SECONDS(1));
		/* Battery level simulation */
		//bas_notify();
		//hrs_notify('E');
		if (!transform(sample))
      		{
                  //Data not yet ready
			}
		else{
		// predict gesture
		printf("Gesture: ");
		printf(predictLabel(features));
		printf("\n");
		hrs_notify('D');
		}
	}
}
```

## src/bluetooth_file.h
```c
#include <bluetooth/bluetooth.h>
#include <bluetooth/hci.h>
#include <bluetooth/conn.h>
#include <bluetooth/uuid.h>
#include <bluetooth/gatt.h>
#include <bluetooth/services/bas.h>
#include <bluetooth/services/hrs.h>

static const struct bt_data ad[] = {
	BT_DATA_BYTES(BT_DATA_FLAGS, (BT_LE_AD_GENERAL | BT_LE_AD_NO_BREDR)),
	BT_DATA_BYTES(BT_DATA_UUID16_ALL,
		      BT_UUID_16_ENCODE(BT_UUID_HRS_VAL),
		      BT_UUID_16_ENCODE(BT_UUID_BAS_VAL),
		      BT_UUID_16_ENCODE(BT_UUID_DIS_VAL))
};

static void connected(struct bt_conn *conn, uint8_t err)
{
	if (err) {
		printk("Connection failed (err 0x%02x)\n", err);
	} else {
		printk("Connected\n");
	}
}

static void disconnected(struct bt_conn *conn, uint8_t reason)
{
	printk("Disconnected (reason 0x%02x)\n", reason);
}

BT_CONN_CB_DEFINE(conn_callbacks) = {
	.connected = connected,
	.disconnected = disconnected,
};

static void bt_ready(void)
{
	int err;

	printk("Bluetooth initialized\n");

	err = bt_le_adv_start(BT_LE_ADV_CONN_NAME, ad, ARRAY_SIZE(ad), NULL, 0);
	if (err) {
		printk("Advertising failed to start (err %d)\n", err);
		return;
	}

	printk("Advertising successfully started\n");
}

static void auth_cancel(struct bt_conn *conn)
{
	char addr[BT_ADDR_LE_STR_LEN];

	bt_addr_le_to_str(bt_conn_get_dst(conn), addr, sizeof(addr));

	printk("Pairing cancelled: %s\n", addr);
}

static struct bt_conn_auth_cb auth_cb_display = {
	.cancel = auth_cancel,
};
```

## src/classifier.h
```c
#include <stdlib.h>
#include <stdio.h>

int predict(float *x) {
 uint8_t votes[4] = { 0 };
 // tree #1
 if (x[17] <= 17.764975547790527) {
     if (x[13] <= 1.9636380076408386) {
         if (x[38] <= 27.5) {
             votes[1] += 1;
         }

         else {
             votes[0] += 1;
         }
     }

     else {
         votes[3] += 1;
     }
 }

 else {
     votes[2] += 1;
 }

 // tree #2
 if (x[27] <= 2.0515599846839905) {
     if (x[1] <= 3.3375165462493896) {
         votes[0] += 1;
     }

     else {
         votes[1] += 1;
     }
 }

 else {
     if (x[33] <= 1.2268590033054352) {
         votes[3] += 1;
     }

     else {
         votes[2] += 1;
     }
 }

 // tree #3
 if (x[45] <= 0.42716532945632935) {
     votes[0] += 1;
 }

 else {
     if (x[19] <= 15.109806537628174) {
         votes[1] += 1;
     }

     else {
         votes[2] += 1;
     }
 }

 // tree #4
 if (x[16] <= 2.6623520851135254) {
     if (x[36] <= -0.09625046327710152) {
         if (x[19] <= 13.393163681030273) {
             votes[1] += 1;
         }

         else {
             votes[3] += 1;
         }
     }

     else {
         votes[2] += 1;
     }
 }

 else {
     votes[0] += 1;
 }

 // tree #5
 if (x[13] <= 1.3375637531280518) {
     votes[0] += 1;
 }

 else {
     if (x[23] <= 25.5) {
         if (x[41] <= 2.6922695636749268) {
             votes[1] += 1;
         }

         else {
             votes[3] += 1;
         }
     }

     else {
         votes[2] += 1;
     }
 }

 // tree #6
 if (x[19] <= 8.504203796386719) {
     votes[0] += 1;
 }

 else {
     if (x[8] <= -3.333926558494568) {
         if (x[22] <= 28.0) {
             votes[2] += 1;
         }

         else {
             votes[3] += 1;
         }
     }

     else {
         votes[1] += 1;
     }
 }

 // tree #7
 if (x[33] <= 1.5381540060043335) {
     if (x[39] <= 25.0) {
         if (x[19] <= 11.42752456665039) {
             votes[0] += 1;
         }

         else {
             votes[3] += 1;
         }
     }

     else {
         votes[1] += 1;
     }
 }

 else {
     votes[2] += 1;
 }

 // tree #8
 if (x[40] <= -1.0083599984645844) {
     if (x[43] <= 2.2642639875411987) {
         votes[1] += 1;
     }

     else {
         if (x[47] <= 32.5) {
             votes[2] += 1;
         }

         else {
             votes[3] += 1;
         }
     }
 }

 else {
     votes[0] += 1;
 }

 // tree #9
 if (x[31] <= 28.5) {
     if (x[4] <= 0.7493155598640442) {
         votes[0] += 1;
     }

     else {
         if (x[27] <= 2.67215096950531) {
             votes[1] += 1;
         }

         else {
             votes[3] += 1;
         }
     }
 }

 else {
     votes[2] += 1;
 }

 // tree #10
 if (x[24] <= -1.5206334590911865) {
     if (x[40] <= -1.8024845123291016) {
         if (x[19] <= 18.25698471069336) {
             votes[3] += 1;
         }

         else {
             votes[2] += 1;
         }
     }

     else {
         votes[1] += 1;
     }
 }

 else {
     votes[0] += 1;
 }

 // return argmax of votes
 uint8_t classIdx = 0;
 float maxVotes = votes[0];

 for (uint8_t i = 1; i < 4; i++) {
     if (votes[i] > maxVotes) {
         classIdx = i;
         maxVotes = votes[i];
     }
 }

 return classIdx;
 }
const char* idxToLabel(uint8_t classIdx) {
    switch (classIdx) {
        case 0:
        return "stationary";
        case 1:
        return "circle";
        case 2:
        return "square";
        case 3:
        return "triangle";
        default:
        return "Houston we have a problem";
    }
}
/**
* Predict readable class name
*/
const char* predictLabel(float *x) {
    return idxToLabel(predict(x));
}
```

## src/window.h
```c
#include <math.h>
#include <stdlib.h>
#include <stdio.h>

extern const uint16_t features_count;
extern float features[48];
extern uint16_t head;
extern float queue[246];

static double sqrt(double value)
{
	double sqrt = value / 3;
	int i;

	if (value <= 0) {
		return 0;
	}

	for (i = 0; i < 6; i++) {
		sqrt = (sqrt + value / sqrt) / 2;
	}

	return sqrt;
}
/**
 * Extract features
 */
 bool transform(float *x) {
    // append source to queue
    memcpy(queue + head, x, sizeof(float) * 6);
    head += 6;
    if (head != 246) {
        return false;
    }
    // extract features for each axis
    uint16_t feature_idx = 0;
    for (uint16_t j = 0; j < 6; j++) {
        float m = queue[j];
        float M = m;
        float abs_m = abs(m);
        float abs_M = abs_m;
        float mean = m;
        float std = 0;
        float count_above_mean = 0;
        float count_below_mean = 0;
        // first-order features
        for (uint16_t i = j + 6; i < 246; i += 6) {
            float xi = queue[i];
            float abs_xi = abs(xi);
            mean += xi;
            if (xi < m) m = xi;
            if (xi > M) M = xi;
            if (abs_xi < abs_m) abs_m = abs_xi;
            if (abs_xi > abs_M) abs_M = abs_xi;
        }
        mean /= 41;
        // second-order features
        for (uint16_t i = j; i < 246; i += 6) {
            float xi = queue[i];
            float x0 = xi - mean;
            std += x0 * x0;
            if (x0 > 0) count_above_mean += 1;
            else count_below_mean += 1;
        }
        std = sqrt(std / 41);
        features[feature_idx++] = m;
        features[feature_idx++] = M;
        features[feature_idx++] = abs_m;
        features[feature_idx++] = abs_M;
        features[feature_idx++] = mean;
        features[feature_idx++] = std;
        features[feature_idx++] = count_above_mean;
        features[feature_idx++] = count_below_mean;
    }
    // copy to dest, if any
    //if (dest != NULL) memcpy(dest, features, sizeof(float) * 48);
    // shift
    memcpy(queue, queue + 120, sizeof(float) * 126);
    head -= 120;
    return true;
 }
 /**
  * Clear the current data of the window
  */
 void clear() {
    head = 0;
 }
```
