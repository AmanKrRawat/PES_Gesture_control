## CMakeLists.txt
```
# SPDX-License-Identifier: Apache-2.0

cmake_minimum_required(VERSION 3.20.0)
set(DTC_OVERLAY_FILE nrf52840dk_nrf52840.overlay)
find_package(Zephyr REQUIRED HINTS $ENV{ZEPHYR_BASE})
project(MPU6050_Embedded_project)

FILE(GLOB app_sources src/*.c)
target_sources(app PRIVATE
  ${app_sources}
  )

zephyr_library_include_directories(${ZEPHYR_BASE}/samples/bluetooth)
```

## prj.conf
```kconfig
CONFIG_BT=y
CONFIG_BT_DEBUG_LOG=y
CONFIG_BT_SMP=y
CONFIG_BT_PERIPHERAL=y
CONFIG_BT_DIS=y
CONFIG_BT_DIS_PNP=n
CONFIG_BT_BAS=y
CONFIG_BT_HRS=y
CONFIG_BT_DEVICE_NAME="Zephyr Heartrate Sensor"
CONFIG_BT_DEVICE_APPEARANCE=833
CONFIG_I2C=y
CONFIG_SENSOR=y
CONFIG_MPU6050=y
CONFIG_I2C_NRFX=y
CONFIG_MPU6050_TRIGGER_NONE=y
CONFIG_CBPRINTF_FP_SUPPORT=y
CONFIG_USE_SEGGER_RTT=y
CONFIG_RTT_CONSOLE=y
CONFIG_UART_CONSOLE=y
CONFIG_NEWLIB_LIBC=y
```

## src/main.c
```c
/* main.c - Application main entry point */

/*
 * Copyright (c) 2015-2016 Intel Corporation
 *
 * SPDX-License-Identifier: Apache-2.0
 */

#include <zephyr/types.h>
#include <stddef.h>
#include <string.h>
#include <errno.h>
#include <sys/printk.h>
#include <sys/byteorder.h>
#include <zephyr.h>
#include <device.h>
#include <stdio.h>
#include <drivers/sensor.h>
#include <stdlib.h>
#include <math.h>
#include "bluetooth_file.h"
#include "window.h"
#include "classifier.h"
#include "button_config.h"
float sample[6] = {0};

const uint16_t features_count = 48;
float features[48];
uint16_t head = 0;
float queue[246];

enum states {menu_state, shape_state, game_state};
enum game_movements {stop,left,right,up,down};
enum shapes {nothing, circle, tick, line};
int state = menu_state;
int current_menu = 0;
int game_move = stop;
int shape = nothing;
char send_command=0;
char send_command_old=0;
int button_press = 0;

double theta_x;
double theta_y;
double theta_z;
double arx, ary, arz;
double rx, ry, rz;

extern void button_init();

static void command_notify(char menu)
{
	bt_hrs_notify(menu);
}
void get_accel_values(void)
{

}
void get_gyro_values(void)
{
	if(rx<-25)
	{
		printf("down\n");
		send_command= 'D';
	}

	else if(rx>25)
	{
		printf("Up\n");
		send_command= 'U';
	}

	else if(ry>25)
	{
		printf("Right\n");
		send_command= 'R';
	}

	else if(ry<-25)
	{
		printf("Left\n");
		send_command= 'L';
	}
}

void identify_shape()
{
	if (!transform(sample))
      	{
                  //Data not yet ready
		}
		else{
		// predict gesture
		printf("Gesture: ");
		printf(predictLabel(features));
		printf("\n");
		send_command = predictLabel(features);
		//hrs_notify('D');
		}

}
void handle_data(void)
{
	if(state == menu_state)
	{
		get_gyro_values();
		if(button_press == 1)
 		{
 			button_press = 0;
			send_command = 'C';
			if(current_menu == 0)
				state = shape_state;
			if(current_menu == 1)
				state = game_state;
 		}
 		if(button_press == 2)
 		{
 			state = menu_state;
 			button_press = 0;
 		}
	}
	else if(state == game_state)
	{
		get_gyro_values();
		if(button_press == 1)
		{
			send_command = 'C';
			game_move = stop;
			button_press = 0;
		}
		if(button_press == 2)
		{
			send_command = 'B';
			game_move = stop;
			button_press = 0;
			state = menu_state;
		}
	}
	else if(state == shape_state)
	{
		identify_shape();
		if(button_press == 1)
		{
			send_command = 'C';
			shape = nothing;
			button_press = 0;
		}
		if(button_press == 2)
		{
			send_command = 'B';
			shape = nothing;
			button_press = 0;
			state = menu_state;
		}
	}
	if(send_command != send_command_old)
	{
		if(state == menu_state && send_command == 'D')
		{
			current_menu = 1;
		}
		if(state == menu_state && send_command == 'U')
		{
			current_menu = 0;
		}
		command_notify(send_command);
	}
	send_command_old = send_command;
}

static int process_mpu6050(const struct device *dev)
{
	struct sensor_value accel[3];
	struct sensor_value gyro[3];
	int rc = sensor_sample_fetch(dev);

	if (rc == 0) {
		rc = sensor_channel_get(dev, SENSOR_CHAN_ACCEL_XYZ, accel);
	}
	if (rc == 0) {
		rc = sensor_channel_get(dev, SENSOR_CHAN_GYRO_XYZ, gyro);
	}
	if (rc == 0) {
		/*printf("%f,%f,%f,%f,%f,%f\n",
		       sensor_value_to_double(&accel[0]),
		       sensor_value_to_double(&accel[1]),
		       sensor_value_to_double(&accel[2]),
		       sensor_value_to_double(&gyro[0]),
		       sensor_value_to_double(&gyro[1]),
		       sensor_value_to_double(&gyro[2])); */
	} else {
		printf("sample fetch/get failed: %d\n", rc);
	}
	sample[0] = sensor_value_to_double(&accel[0]);
	sample[1] = sensor_value_to_double(&accel[1]);
	sample[2] = sensor_value_to_double(&accel[2]);
	sample[3] = sensor_value_to_double(&gyro[0]);
	sample[4] = sensor_value_to_double(&gyro[1]);
	sample[5] = sensor_value_to_double(&gyro[2]);
	theta_x = theta_x + sample[3]*0.05/1000;
    theta_y = theta_y + sample[4]*0.05/1000;
	theta_z = theta_z + sample[5]*0.05/1000;

	arx = (180/3.141592) * atan(sample[0] / sqrt(sample[1]*sample[1] + sample[2]*sample[2])); 
	ary = (180/3.141592) * atan(sample[1] / sqrt(sample[0]*sample[0] + sample[2]*sample[2]));
	arz = (180/3.141592) * atan(sqrt(sample[1]*sample[1] + sample[0]*sample[0]) / sample[2]);
	rx = (0.96 * arx) + (0.04 * theta_x);
    ry = (0.96 * ary) + (0.04 * theta_y);
    rz = (0.96 * arz) + (0.04 * theta_z);
	printf("%f %f %f", arx, ary, arz);
	handle_data();
	return rc;
}



void main(void)
{
	int err;
	err = bt_enable(NULL);
	if (err) {
		printk("Bluetooth init failed (err %d)\n", err);
		return;
	}
	bt_ready();
	bt_conn_auth_cb_register(&auth_cb_display);

	const char *const label = DT_LABEL(DT_INST(0, invensense_mpu6050));
	const struct device *mpu6050 = device_get_binding(label);

	button_init();

	if (!mpu6050) {
		printf("Failed to find sensor %s\n", label);
		return;
	}

	/* Implement notification. At the moment there is no suitable way
	 * of starting delayed work so we do it here
	 */
	while (1) {
		k_sleep(K_SECONDS(0.05));
		int rc = process_mpu6050(mpu6050);
		
	}
}
```

## src/classifier.h
```c
#include <stdlib.h>
#include <stdio.h>



int predict(float *x) {
                        uint8_t votes[4] = { 0 };
                        // tree #1
                        if (x[17] <= 9.0) {
                            votes[0] += 1;
                        }

                        else {
                            if (x[21] <= 3.0173362493515015) {
                                votes[1] += 1;
                            }

                            else {
                                if (x[40] <= -3.5) {
                                    votes[2] += 1;
                                }

                                else {
                                    if (x[22] <= 23.5) {
                                        votes[3] += 1;
                                    }

                                    else {
                                        votes[2] += 1;
                                    }
                                }
                            }
                        }

                        // tree #2
                        if (x[21] <= 3.0173362493515015) {
                            if (x[47] <= 34.0) {
                                votes[1] += 1;
                            }

                            else {
                                votes[0] += 1;
                            }
                        }

                        else {
                            if (x[0] <= -4.5) {
                                if (x[5] <= 2.3038597106933594) {
                                    votes[3] += 1;
                                }

                                else {
                                    votes[2] += 1;
                                }
                            }

                            else {
                                votes[3] += 1;
                            }
                        }

                        // tree #3
                        if (x[45] <= 0.5707090198993683) {
                            votes[0] += 1;
                        }

                        else {
                            if (x[21] <= 3.0173362493515015) {
                                votes[1] += 1;
                            }

                            else {
                                if (x[40] <= -3.5) {
                                    votes[2] += 1;
                                }

                                else {
                                    if (x[35] <= 3.5) {
                                        votes[3] += 1;
                                    }

                                    else {
                                        votes[2] += 1;
                                    }
                                }
                            }
                        }

                        // tree #4
                        if (x[16] <= -5.5) {
                            votes[2] += 1;
                        }

                        else {
                            if (x[47] <= 32.5) {
                                if (x[19] <= 16.0) {
                                    votes[1] += 1;
                                }

                                else {
                                    votes[3] += 1;
                                }
                            }

                            else {
                                if (x[9] <= 3.5) {
                                    votes[0] += 1;
                                }

                                else {
                                    votes[3] += 1;
                                }
                            }
                        }

                        // tree #5
                        if (x[6] <= 21.5) {
                            if (x[8] <= -6.0) {
                                votes[3] += 1;
                            }

                            else {
                                votes[0] += 1;
                            }
                        }

                        else {
                            if (x[1] <= 3.5) {
                                if (x[13] <= 3.629316568374634) {
                                    votes[3] += 1;
                                }

                                else {
                                    votes[1] += 1;
                                }
                            }

                            else {
                                votes[2] += 1;
                            }
                        }

                        // tree #6
                        if (x[19] <= 9.0) {
                            votes[0] += 1;
                        }

                        else {
                            if (x[23] <= 21.5) {
                                if (x[7] <= 19.5) {
                                    votes[2] += 1;
                                }

                                else {
                                    votes[3] += 1;
                                }
                            }

                            else {
                                if (x[6] <= 19.5) {
                                    votes[3] += 1;
                                }

                                else {
                                    votes[1] += 1;
                                }
                            }
                        }

                        // tree #7
                        if (x[35] <= 3.5) {
                            if (x[0] <= -7.0) {
                                votes[1] += 1;
                            }

                            else {
                                if (x[19] <= 10.0) {
                                    votes[0] += 1;
                                }

                                else {
                                    votes[3] += 1;
                                }
                            }
                        }

                        else {
                            votes[2] += 1;
                        }

                        // tree #8
                        if (x[40] <= -1.0) {
                            if (x[21] <= 3.0512475967407227) {
                                votes[1] += 1;
                            }

                            else {
                                if (x[6] <= 22.0) {
                                    votes[3] += 1;
                                }

                                else {
                                    if (x[21] <= 5.1657350063323975) {
                                        if (x[0] <= -4.5) {
                                            votes[2] += 1;
                                        }

                                        else {
                                            votes[3] += 1;
                                        }
                                    }

                                    else {
                                        votes[2] += 1;
                                    }
                                }
                            }
                        }

                        else {
                            votes[0] += 1;
                        }

                        // tree #9
                        if (x[8] <= -5.0) {
                            if (x[35] <= 1.5) {
                                votes[1] += 1;
                            }

                            else {
                                if (x[46] <= 8.0) {
                                    votes[3] += 1;
                                }

                                else {
                                    if (x[16] <= -5.0) {
                                        votes[2] += 1;
                                    }

                                    else {
                                        votes[3] += 1;
                                    }
                                }
                            }
                        }

                        else {
                            votes[0] += 1;
                        }

                        // tree #10
                        if (x[24] <= -0.5) {
                            if (x[39] <= 37.0) {
                                if (x[35] <= 3.5) {
                                    if (x[32] <= -1.5) {
                                        votes[3] += 1;
                                    }

                                    else {
                                        votes[1] += 1;
                                    }
                                }

                                else {
                                    votes[2] += 1;
                                }
                            }

                            else {
                                votes[1] += 1;
                            }
                        }

                        else {
                            votes[0] += 1;
                        }

                        // return argmax of votes
                        uint8_t classIdx = 0;
                        float maxVotes = votes[0];

                        for (uint8_t i = 1; i < 4; i++) {
                            if (votes[i] > maxVotes) {
                                classIdx = i;
                                maxVotes = votes[i];
                            }
                        }

                        return classIdx;
                    }

const char idxToLabel(uint8_t classIdx) {
                        switch (classIdx) {
                            case 0:
                            return 'S';
                            case 1:
                            return 'L';
                            case 2:
                            return 'T';
                            case 3:
                            return 'R';
                            default:
                            return 'X';
                        }
                    }

/**
* Predict readable class name
*/
const char predictLabel(float *x) {
    return idxToLabel(predict(x));
}
```

## src/window.h
```c
#include <stdlib.h>
#include <stdio.h>
extern const uint16_t features_count;
extern float features[48];
extern uint16_t head;
extern float queue[246];

double sqrt(double value)
{
	double sqrt = value / 3;
	int i;

	if (value <= 0) {
		return 0;
	}

	for (i = 0; i < 6; i++) {
		sqrt = (sqrt + value / sqrt) / 2;
	}

	return sqrt;
}
/**
 * Extract features
 */
bool transform(float *x) {
// append source to queue
                    memcpy(queue + head, x, sizeof(float) * 6);
                    head += 6;

                    if (head != 246) {
                        return false;
                    }

                    // extract features for each axis
                    uint16_t feature_idx = 0;

                    for (uint16_t j = 0; j < 6; j++) {
                        float m = queue[j];
                        float M = m;
                        float abs_m = abs(m);
                        float abs_M = abs_m;
                        float mean = m;
                        float std = 0;
                        float count_above_mean = 0;
                        float count_below_mean = 0;

                        // first-order features
                        for (uint16_t i = j + 6; i < 246; i += 6) {
                            float xi = queue[i];
                            float abs_xi = abs(xi);

                            mean += xi;

                            if (xi < m) m = xi;
                            if (xi > M) M = xi;
                            if (abs_xi < abs_m) abs_m = abs_xi;
                            if (abs_xi > abs_M) abs_M = abs_xi;
                        }

                        mean /= 41;

                        // second-order features
                        for (uint16_t i = j; i < 246; i += 6) {
                            float xi = queue[i];
                            float x0 = xi - mean;

                            std += x0 * x0;

                            if (x0 > 0) count_above_mean += 1;
                            else count_below_mean += 1;
                        }

                        std = sqrt(std / 41);

                        features[feature_idx++] = m;
                        features[feature_idx++] = M;
                        features[feature_idx++] = abs_m;
                        features[feature_idx++] = abs_M;
                        features[feature_idx++] = mean;
                        features[feature_idx++] = std;
                        features[feature_idx++] = count_above_mean;
                        features[feature_idx++] = count_below_mean;
                    }
                    
                    // shift
                    memcpy(queue, queue + 120, sizeof(float) * 126);
                    head -= 120;

                    return true;
                 }

 /**
  * Clear the current data of the window
  */
 void clear() {
    head = 0;
 }
```
